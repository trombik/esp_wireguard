## Kconfig
```kconfig
menu "WireGuard"

choice WIREGUARD_ESP_ADAPTER_SELECTION
    prompt "TCP/IP adapter to use"
    default WIREGUARD_ESP_NETIF
    config WIREGUARD_ESP_TCPIP_ADAPTER
        bool "TCP/IP Adapter (pre esp-idf v4.1, ESP8266 RTOS SDK)"
    config WIREGUARD_ESP_NETIF
        bool "ESP-NETIF"
endchoice

config WIREGUARD_MAX_PEERS
    int "Max number of peers"
    default 1

config WIREGUARD_MAX_SRC_IPS
	int "Max number of SRC IP addresses"
	default 2

config MAX_INITIATIONS_PER_SECOND
    int "Per device limit on accepting (valid) initiation requests"
    default 2
    help
        Per device limit on accepting (valid) initiation requests - per peer.
endmenu
```

## examples/demo/main/Kconfig.projbuild
```kconfig
menu "Example Configuration"

    config ESP_WIFI_SSID
        string "WiFi SSID"
        default "myssid"
        help
            SSID (network name) for the example to connect to.

    config ESP_WIFI_PASSWORD
        string "WiFi Password"
        default "mypassword"
        help
            WiFi password (WPA or WPA2) for the example to use.

    config ESP_MAXIMUM_RETRY
        int "Maximum retry"
        default 5
        help
            Set the Maximum retry to avoid station reconnecting to the AP
            unlimited when the AP is really inexistent.

    config WG_PRIVATE_KEY
        string "Wireguard Private Key"
        default "AAAAAAAAAAAAAAAAAAAAAAAAAAAAAAAAA="
        help
            Private key of the WireGuard device.

    config WG_LOCAL_IP_ADDRESS
        string "Wireguard local IP address"
        default "10.0.0.2"
        help
            Local IP address of the WireGuard device.

    config WG_LOCAL_IP_NETMASK
        string "Wireguard local netmask"
        default "255.255.255.255"
        help
            Netmask of the local network the WireGuard device belongs to.

    config WG_LOCAL_PORT
        int "Wireguard local port"
        default 53820
        help
            Local port to listen.

    config WG_PEER_ONE_PUBLIC_KEY
        string "Wireguard remote peer public key"
        default "AAAAAAAAAAAAAAAAAAAAAAAAAAAAAAAAA="
        help
            Public key of the 1st remote peer.

    config WG_PEER_TWO_PUBLIC_KEY
        string "Wireguard remote peer public key"
        default "AAAAAAAAAAAAAAAAAAAAAAAAAAAAAAAAA="
        help
            Public key of the 2nd remote peer.

    config WG_PRESHARED_KEY
        string "Wireguard pre-shared symmetric key"
        default ""
        help
            Public key of the remote peer.

    config WG_PEER_ONE_ADDRESS
        string "Wireguard remote peer address"
        default "10.0.0.1"
        help
            Address of the 1st remote peer.

    config WG_PEER_TWO_ADDRESS
        string "Wireguard remote peer address"
        default "10.0.0.3"
        help
            Address of the 2nd remote peer.

    config WG_PEER_ONE_ENDPOINT
        string "Wireguard remote peer endpoint"
        default "192.168.178.27"
        help
            Address of the 1st remote peer.

    config WG_PEER_TWO_ENDPOINT
        string "Wireguard remote peer endpoint"
        default "192.168.178.79"
        help
            Address of the 2nd remote peer.

    config WG_PEER_ONE_MASK
        string "Wireguard remote peer net mask"
        default "255.255.255.255"
        help
            Address of the 1st remote peer netmask

    config WG_PEER_TWO_MASK
        string "Wireguard remote peer net mask"
        default "255.255.255.255"
        help
            Address of the 2nd remote peer netmask

    config WG_PEER_ONE_PORT
        int "Wireguard remote peer port"
        default 51820
        help
            Port number of the remote peer.

    config WG_PEER_TWO_PORT
        int "Wireguard remote peer port"
        default 43524
        help
            Port number of the remote peer.

    config WG_PERSISTENT_KEEP_ALIVE
        int "Interval to send an authenticated empty packet"
        default 0
        help
            A seconds interval, between 1 and 65535 inclusive, of how often to
            send an authenticated empty packet to the peer for the purpose of
            keeping a stateful firewall or NAT mapping valid persistently
    config EXAMPLE_PING_ADDRESS
        string "Target IP address or name"
        default "10.0.0.1"
        help
            Target IP address to send ICMP echo requests.

    config EXAMPLE_FALSE_ADDRESS
        string "Target IP address or name"
        default "10.0.2.3"
        help
            Target IP address to send ICMP echo requests.
endmenu
```

## examples/demo_qemu/main/Kconfig.projbuild
```kconfig
menu "Example Configuration"

    config ESP_MAXIMUM_RETRY
        int "Maximum retry"
        default 5
        help
            Set the Maximum retry to avoid station reconnecting to the AP
            unlimited when the AP is really inexistent.

    config WG_PRIVATE_KEY
        string "Wireguard Private Key"
        # The key is intended for testing purposes only and should never be used in a real environment.
        default "gBzqhni+8zFtpmeUEbneHu6zs/mesRLmxVFzqDyFJlg="
        help
            Private key of the WireGuard device.

    config WG_LOCAL_IP_ADDRESS
        string "Wireguard local IP address"
        default "10.0.0.1"
        help
            Local IP address of the WireGuard device.

    config WG_LOCAL_IP_NETMASK
        string "Wireguard local netmask"
        default "255.255.255.0"
        help
            Netmask of the local network the WireGuard device belongs to.

    config WG_LOCAL_PORT
        int "Wireguard local port"
        default 53820
        help
            Local port to listen.

    config WG_PEER_ONE_PUBLIC_KEY
        string "Wireguard remote peer public key"
        default "jWaXciJv964gZHlLBSB6PHzm9AGyVuLjP6hChdPpbSE="
        help
            Public key of the 1st remote peer.

    config WG_PEER_TWO_PUBLIC_KEY
        string "Wireguard remote peer public key"
        default "4woa7xaCYz2gOgr0HHPT2GXPjuamtVCe9OQvIWBd4RQ="
        help
            Public key of the 2nd remote peer.

    config WG_PEER_ONE_ADDRESS
        string "Wireguard remote peer address"
        default "10.0.0.2"
        help
            Address of the 1st remote peer.

    config WG_PEER_TWO_ADDRESS
        string "Wireguard remote peer address"
        default "10.0.0.3"
        help
            Address of the 2nd remote peer.

    config WG_PEER_ONE_ENDPOINT
        string "Wireguard remote peer endpoint"
        default "172.18.0.3"
        help
            Address of the 1st remote peer.

    config WG_PEER_TWO_ENDPOINT
        string "Wireguard remote peer endpoint"
        default "172.18.0.5"
        help
            Address of the 2nd remote peer.

    config WG_PEER_ONE_MASK
        string "Wireguard remote peer net mask"
        default "255.255.255.255"
        help
            Address of the 1st remote peer netmask

    config WG_PEER_TWO_MASK
        string "Wireguard remote peer net mask"
        default "255.255.255.255"
        help
            Address of the 2nd remote peer netmask

    config WG_PEER_ONE_PORT
        int "Wireguard remote peer port"
        default 51821
        help
            Port number of the remote peer.

    config WG_PEER_TWO_PORT
        int "Wireguard remote peer port"
        default 51822
        help
            Port number of the remote peer.

    config WG_PERSISTENT_KEEP_ALIVE
        int "Interval to send an authenticated empty packet"
        default 1
        help
            A seconds interval, between 1 and 65535 inclusive, of how often to
            send an authenticated empty packet to the peer for the purpose of
            keeping a stateful firewall or NAT mapping valid persistently

    config EXAMPLE_FALSE_ADDRESS
        string "Target IP address or name"
        default "10.0.2.3"
        help
            Target IP address to send ICMP echo requests.
endmenu
```

## examples/icmp/main/Kconfig.projbuild
```kconfig
menu "Example Configuration"

    config ESP_WIFI_SSID
        string "WiFi SSID"
        default "myssid"
        help
            SSID (network name) for the example to connect to.

    config ESP_WIFI_PASSWORD
        string "WiFi Password"
        default "mypassword"
        help
            WiFi password (WPA or WPA2) for the example to use.

    config ESP_MAXIMUM_RETRY
        int "Maximum retry"
        default 5
        help
            Set the Maximum retry to avoid station reconnecting to the AP unlimited when the AP is really inexistent.
    
    config WG_PRIVATE_KEY
        string "Wireguard Private Key"
        default ""
        help
            Private key of the WireGuard device.
    
    config WG_LOCAL_IP_ADDRESS
        string "Wireguard local IP address"
        default ""
        help
            Local IP address of the WireGuard device.
    
    config WG_LOCAL_IP_NETMASK
        string "Wireguard local netmask"
        default "255.255.255.255"
        help
            Netmask of the local network the WireGuard device belongs to.
    
    config WG_LOCAL_PORT
        int "Wireguard local port"
        default 11010
        help
            Local port to listen.
    
    config WG_PEER_PUBLIC_KEY
        string "Wireguard remote peer public key"
        default ""
        help
            Public key of the remote peer.
    
    config WG_PEER_ADDRESS
        string "Wireguard remote peer address"
        default "link.arc.soracom.io"
        help
            Address of the remote peer.
    
    config WG_PEER_PORT
        int "Wireguard remote peer port"
        default 11010
        help
            Port number of the remote peer.
    
    config EXAMPLE_PING_ADDRESS
        string "ICMP echo request target address"
        default "pong.soracom.io"
        help
            Address of the target of the ping (ICMP echo request).
    

endmenu
```
